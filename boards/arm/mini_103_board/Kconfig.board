## boards/arm/mini_103_board/Kconfig.board
```kconfig
# NUCLEO-64 F103RB board configuration

# Copyright (c) 2016 Open-RnD Sp. z o.o.
# SPDX-License-Identifier: Apache-2.0

config BOARD_MIMI_103
	bool "MINI F103RB Development Board"
	depends on SOC_STM32F103X8
```

## boards/arm/mini_103_board/Kconfig.defconfig
```kconfig
# NUCLEO-64 F103RB board configuration

# Copyright (c) 2016 Open-RnD Sp. z o.o.
# SPDX-License-Identifier: Apache-2.0

if BOARD_MIMI_103

config BOARD
	default "mini_103_board"

config UART_2
	default y
	depends on UART_CONSOLE

config PWM_STM32_1
	default y
	depends on PWM

config ADC_1
	default y
	depends on ADC

endif # BOARD_MIMI_103
```
